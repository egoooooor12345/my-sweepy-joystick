## Kconfig.defconfig
```kconfig
# Copyright (c) 2020 The ZMK Contributors
# SPDX-License-Identifier: MIT

if SHIELD_SWEEPY_LEFT

config ZMK_KEYBOARD_NAME
    default "sweepy"

config ZMK_SPLIT_ROLE_CENTRAL
    default y

endif

if SHIELD_SWEEPY_LEFT || SHIELD_SWEEPY_RIGHT

config ZMK_SPLIT
    default y

endif
CONFIG_ZMK_JOYSTICK=y
CONFIG_ZMK_INPUT_ALPS_RG11=y
```
